; *************************************************************
; *** Scatter-Loading Description File generated by uVision ***
; *************************************************************

LR_IROM1 0x08000000 0x00080000  {    ; load region size_region
  ER_IROM1 0x08000000 0x00080000  {  ; load address = execution address
   *.o (RESET, +First)
   *(InRoot$$Sections)
    Display.o (+RO)
    Initialize.o (+RO)
    Interrupt.o (+RO)
    main.o (+RO)
    NandInterface.o (+RO)
    NAND.o (+RO)
    Tft.o (+RO)
    RTC_Time.o (+RO)
    serial.o (+RO)
    Flash.o (+RO)
    Watchdog.o (+RO)
    DAC7512Interface.o (+RO)
    Communication.o (+RO)
    Button.o (+RO)
    NANDDisplay.o (+RO)
    CurrentSorceTrans.o (+RO)
    MicroSd.o (+RO)
    sdio_sd.o (+RO)
    eeprom.o (+RO)
    display_icon.o (+RO)
    icon_ch2_ch4.o (+RO)
    misc.o (+RO)
    stm32f10x_adc.o (+RO)
    stm32f10x_bkp.o (+RO)
    stm32f10x_flash.o (+RO)
    stm32f10x_fsmc.o (+RO)
    stm32f10x_gpio.o (+RO)
    stm32f10x_iwdg.o (+RO)
    stm32f10x_pwr.o (+RO)
    stm32f10x_rcc.o (+RO)
    stm32f10x_rtc.o (+RO)
    stm32f10x_sdio.o (+RO)
    stm32f10x_spi.o (+RO)
    stm32f10x_tim.o (+RO)
    stm32f10x_usart.o (+RO)
    stm32f10x_dma.o (+RO)
    stm32f10x_dac.o (+RO)
    stm32f10x_i2c.o (+RO)
    core_cm3.o (+RO)
    system_stm32f10x.o (+RO)
    startup_stm32f10x_hd.o (+RO)
    diskio.o (+RO)
    ff.o (+RO)
    def.o (+RO)
    dhcp.o (+RO)
    dns.o (+RO)
    init.o (+RO)
    mem.o (+RO)
    memp.o (+RO)
    netif.o (+RO)
    pbuf.o (+RO)
    raw.o (+RO)
    stats.o (+RO)
    sys.o (+RO)
    tcp.o (+RO)
    tcp_in.o (+RO)
    tcp_out.o (+RO)
    timers.o (+RO)
    udp.o (+RO)
    autoip.o (+RO)
    icmp.o (+RO)
    igmp.o (+RO)
    inet.o (+RO)
    inet_chksum.o (+RO)
    ip.o (+RO)
    ip_addr.o (+RO)
    ip_frag.o (+RO)
    etharp.o (+RO)
    ethernetif.o (+RO)
    slipif.o (+RO)
    app_ethernet.o (+RO)
    enc28j60.o (+RO)
    main_ethernet.o (+RO)
    modbus_client.o (+RO)
    ethernetif_1.o (+RO)
    system_stm32f1xx.o (+RO)
    stm32f1xx_it.o (+RO)
    stm32f1xx_hal_dac.o (+RO)
    stm32f1xx_hal.o (+RO)
    stm32f1xx_hal_dma.o (+RO)
    stm32f1xx_hal_gpio.o (+RO)
    stm32f1xx_hal_uart.o (+RO)
    stm32f1xx_hal_spi.o (+RO)
    stm32f1xx_hal_rcc.o (+RO)
    stm32f1xx_hal_tim.o (+RO)
    stm32f1xx_hal_dac_ex.o (+RO)
    stm32f1xx_ll_dma.o (+RO)
    stm32f1xx_hal_cortex.o (+RO)
    stm32f1xx_hal_tim_ex.o (+RO)
    stm32f1xx_hal_rcc_ex.o (+RO)
   .ANY (+RO)
  }
  RW_IRAM1 0x20000000 0x00010000  {  ; RW data
    Display.o (+ZI +RW)
    Initialize.o (+ZI +RW)
    Interrupt.o (+ZI +RW)
    main.o (+ZI +RW)
    NandInterface.o (+ZI +RW)
    NAND.o (+ZI +RW)
    Tft.o (+ZI +RW)
    RTC_Time.o (+ZI +RW)
    serial.o (+ZI +RW)
    Flash.o (+ZI +RW)
    Watchdog.o (+ZI +RW)
    DAC7512Interface.o (+ZI +RW)
    Communication.o (+ZI +RW)
    Button.o (+ZI +RW)
    NANDDisplay.o (+ZI +RW)
    CurrentSorceTrans.o (+ZI +RW)
    MicroSd.o (+ZI +RW)
    sdio_sd.o (+ZI +RW)
    eeprom.o (+ZI +RW)
    display_icon.o (+ZI +RW)
    icon_ch2_ch4.o (+ZI +RW)
    misc.o (+ZI +RW)
    stm32f10x_adc.o (+ZI +RW)
    stm32f10x_bkp.o (+ZI +RW)
    stm32f10x_flash.o (+ZI +RW)
    stm32f10x_fsmc.o (+ZI +RW)
    stm32f10x_gpio.o (+ZI +RW)
    stm32f10x_iwdg.o (+ZI +RW)
    stm32f10x_pwr.o (+ZI +RW)
    stm32f10x_rcc.o (+ZI +RW)
    stm32f10x_rtc.o (+ZI +RW)
    stm32f10x_sdio.o (+ZI +RW)
    stm32f10x_spi.o (+ZI +RW)
    stm32f10x_tim.o (+ZI +RW)
    stm32f10x_usart.o (+ZI +RW)
    stm32f10x_dma.o (+ZI +RW)
    stm32f10x_dac.o (+ZI +RW)
    stm32f10x_i2c.o (+ZI +RW)
    core_cm3.o (+ZI +RW)
    system_stm32f10x.o (+ZI +RW)
    startup_stm32f10x_hd.o (+ZI +RW)
    diskio.o (+ZI +RW)
    ff.o (+ZI +RW)
    def.o (+ZI +RW)
    dhcp.o (+ZI +RW)
    dns.o (+ZI +RW)
    init.o (+ZI +RW)
    mem.o (+ZI +RW)
    memp.o (+ZI +RW)
    netif.o (+ZI +RW)
    pbuf.o (+ZI +RW)
    raw.o (+ZI +RW)
    stats.o (+ZI +RW)
    sys.o (+ZI +RW)
    tcp.o (+ZI +RW)
    tcp_in.o (+ZI +RW)
    tcp_out.o (+ZI +RW)
    timers.o (+ZI +RW)
    udp.o (+ZI +RW)
    autoip.o (+ZI +RW)
    icmp.o (+ZI +RW)
    igmp.o (+ZI +RW)
    inet.o (+ZI +RW)
    inet_chksum.o (+ZI +RW)
    ip.o (+ZI +RW)
    ip_addr.o (+ZI +RW)
    ip_frag.o (+ZI +RW)
    etharp.o (+ZI +RW)
    ethernetif.o (+ZI +RW)
    slipif.o (+ZI +RW)
    app_ethernet.o (+ZI +RW)
    enc28j60.o (+ZI +RW)
    main_ethernet.o (+ZI +RW)
    modbus_client.o (+ZI +RW)
    ethernetif_1.o (+ZI +RW)
    system_stm32f1xx.o (+ZI +RW)
    stm32f1xx_it.o (+ZI +RW)
    stm32f1xx_hal_dac.o (+ZI +RW)
    stm32f1xx_hal.o (+ZI +RW)
    stm32f1xx_hal_dma.o (+ZI +RW)
    stm32f1xx_hal_gpio.o (+ZI +RW)
    stm32f1xx_hal_uart.o (+ZI +RW)
    stm32f1xx_hal_spi.o (+ZI +RW)
    stm32f1xx_hal_rcc.o (+ZI +RW)
    stm32f1xx_hal_tim.o (+ZI +RW)
    stm32f1xx_hal_dac_ex.o (+ZI +RW)
    stm32f1xx_ll_dma.o (+ZI +RW)
    stm32f1xx_hal_cortex.o (+ZI +RW)
    stm32f1xx_hal_tim_ex.o (+ZI +RW)
    stm32f1xx_hal_rcc_ex.o (+ZI +RW)
   .ANY (+RW +ZI)
  }
}

